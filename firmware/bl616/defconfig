## firmware/k230_board/rtsmart/drivers/link_mux/Kconfig
```kconfig
config RT_USING_LINK_MUX
    bool "LEAKCAM: console and BL616 link share UART1"
    depends on RT_USING_SERIAL && RT_USING_CONSOLE
    default n
    help
        The K230 console and the BL616 link frames on one wire (UART1 <-> BL616 UART0):
        valid link frames go to /dev/link (leakcam_agent), everything else to the console
        device "kcon" (msh, stdin/stdout). The BL616 shows the console on its second USB
        port. Replaces the CH340 console on UART0 (USB-C 2).
```

## firmware/k230_board/rtsmart/drivers/ota_nand/Kconfig
```kconfig
config RT_USING_OTA_NAND
    bool "LEAKCAM: /dev/ota, the A/B image update on SPI NAND"
    depends on RT_USING_MTD_NAND
    default n
    help
        Writes the inactive RT-Smart slot (rtt_a / rtt_b) and its ota_meta record the way the SPL
        reads them (DESIGN.md 5.3.7): bad blocks skipped, the record last. msh: ota_records.
```

## firmware/k230_board/rtsmart/drivers/sys_stat/Kconfig
```kconfig
config RT_USING_SYS_STAT
    bool "LEAKCAM: /dev/sysstat, the kernel heap and pages for the STATUS frame"
    depends on RT_USING_MEMHEAP_AS_HEAP
    default n
    help
        One read() of the kernel heap (memheaps) and the page allocator's totals and free bytes: the product
        program reports them to the BL616 in its STATUS frame, which passes them to the server (DESIGN.md 5.3.10).
```
